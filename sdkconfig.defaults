## sdkconfig.defaults
```kconfig
# Enable IP Forwarding and NAT
CONFIG_LWIP_IP_FORWARD=y
CONFIG_LWIP_IPV4_NAPT=y
CONFIG_LWIP_L2_TO_L3_COPY=y

# Enable Arduino Autostart
CONFIG_AUTOSTART_ARDUINO=y

# Increase Stack Size if needed (optional)
CONFIG_ARDUINO_LOOP_STACK_SIZE=8192

# Arduino Framework Requirement
CONFIG_FREERTOS_HZ=1000
```
